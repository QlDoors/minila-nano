## boards/shields/minila_nano/Kconfig.defconfig
```kconfig
# Copyright (c) 2021 The ZMK Contributors
# SPDX-License-Identifier: MIT

if SHIELD_MINILA_NANO

config ZMK_KEYBOARD_NAME
    default "MinilaNano"

config MINILA_INDICATORS_LED
    bool "Minila HID Indicators"
    def_bool y
    help
      Enable HID indicators, used for detecting state of Caps/Scroll/Num Lock,
      Kata, and Compose.

config MINILA_BATTERY_LED
    bool "Minila battery led"
    def_bool y

config MINILA_BATTERY_VOL
    int "Minila batter volume, unit mAh"
    default 2000

endif
```

## config/Kconfig.shield
```kconfig
# Copyright (c) 2021 The ZMK Contributors
# SPDX-License-Identifier: MIT 

config SHIELD_MINILA_NANO
    def_bool $(shields_list_contains,minila_nano)
```
